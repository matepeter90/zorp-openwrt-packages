## net/libtre/Config.in
```kconfig
config	libtre
	prompt "libtre.......................... Approximate regex matching library and agrep command line tool"
	tristate
```

## net/zorp-addons/Config.in
```kconfig
config ZORP_ADDONS
	prompt "Zorp addon.......................... Zorp userspace iptables addon"
	tristate
```
